## Documentation/devicetree/bindings/net/wwan/mediatek,mt6785-ccci.yaml
```yaml
# SPDX-License-Identifier: (GPL-2.0-only OR BSD-2-Clause)
%YAML 1.2
---
$id: http://devicetree.org/schemas/net/wwan/mediatek,mt6785-ccci.yaml#
$schema: http://devicetree.org/meta-schemas/core.yaml#

title: MediaTek MT6785 cellular modem (MD1) host interface

maintainers:
  - masterxq <masterxq@users.noreply.github.com>

description: |
  The MT6785 contains a cellular modem subsystem (MD1, LTE/WCDMA/GSM). The
  bootloader loads and verifies the modem image, places it in reserved
  memory and hands the layout over in /chosen (ccci,modem_info_v2); the
  application processor powers the modem subsystem, sets its boot slave
  register and talks to it over the cross-core interrupt controller CCIF0
  (control channel, ring buffers in shared memory). Packet data goes over
  the data path interface DPMAIF (descriptor rings in application processor
  memory, one interrupt). This node describes the application processor side
  of that interface (CCCI). The DPMAIF resources are optional: without them
  only the control channel is used.

properties:
  compatible:
    const: mediatek,mt6785-ccci

  reg:
    minItems: 5
    items:
      - description: CCIF0, application processor side
      - description: CCIF0, modem side
      - description: CCIF4, modem side
      - description: BROM pass flags in the security always-on block
      - description: Boot slave enable register of the modem
      - description: DPMAIF uplink, always-on part
      - description: DPMAIF downlink, always-on part
      - description: DPMAIF uplink, power-down part
      - description: DPMAIF downlink, power-down part
      - description: DPMAIF interrupt and misc control, power-down part
      - description: DPMAIF modem side misc control
      - description: DPMAIF internal SRAM (debug)
  reg-names:
    minItems: 5
    items:
      - const: ap-ccif
      - const: md-ccif
      - const: md-ccif4
      - const: sec-ao
      - const: md-boot
      - const: dpmaif-ao-ul
      - const: dpmaif-ao-dl
      - const: dpmaif-pd-ul
      - const: dpmaif-pd-dl
      - const: dpmaif-pd-misc
      - const: dpmaif-pd-md-misc
      - const: dpmaif-sram

  interrupts:
    minItems: 3
    items:
      - description: Modem watchdog
      - description: CCIF0 data channels
      - description: CCIF0 control and exception channels
      - description: DPMAIF
  interrupt-names:
    minItems: 3
    items:
      - const: mdwdt
      - const: ccif0-data
      - const: ccif0-ctrl
      - const: dpmaif

  clocks:
    minItems: 7
    items:
      - description: CCIF0 AP side
      - description: CCIF0 MD side
      - description: CCIF1 AP side
      - description: CCIF1 MD side
      - description: CCIF2 AP side
      - description: CCIF2 MD side
      - description: CCIF4 MD side
      - description: DPMAIF
  clock-names:
    minItems: 7
    items:
      - const: ccif-ap
      - const: ccif-md
      - const: ccif1-ap
      - const: ccif1-md
      - const: ccif2-ap
      - const: ccif2-md
      - const: ccif4-md
      - const: dpmaif

  resets:
    minItems: 1
    maxItems: 3
  reset-names:
    minItems: 1
    items:
      - const: ccif0
      - const: dpmaif-ao
      - const: dpmaif-pd

  mediatek,infracfg:
    $ref: /schemas/types.yaml#/definitions/phandle
    description: INFRACFG_AO syscon (modem clock request, bus protection).

  mediatek,infracfg-nao:
    $ref: /schemas/types.yaml#/definitions/phandle
    description: INFRACFG_NAO syscon (modem boot status).

  mediatek,scpsys:
    $ref: /schemas/types.yaml#/definitions/phandle
    description: SCPSYS syscon with the MD1 power control registers.

  mediatek,pwrap:
    $ref: /schemas/types.yaml#/definitions/phandle
    description: PMIC wrapper of the MT6359 (26 MHz buffer low power select).

  vmodem-supply:
    description: Modem core supply (MT6359 VMODEM).

  vsram-md-supply:
    description: Modem SRAM supply (MT6359 VSRAM_MD).

  mediatek,swtp-gpios:
    maxItems: 1
    description:
      Transmit power switch input (SWTP, "RF_cable" in the vendor driver).
      The application processor reports the transmit power state derived
      from this line to the modem at boot and on every change.

  io-channels:
    maxItems: 1
    description: AUXADC channel the modem asks for at boot.
  io-channel-names:
    items:
      - const: md-channel

required:
  - compatible
  - reg
  - reg-names
  - interrupts
  - clocks
  - clock-names
  - resets
  - reset-names
  - mediatek,infracfg
  - mediatek,infracfg-nao
  - mediatek,scpsys
  - mediatek,pwrap
  - vmodem-supply
  - vsram-md-supply

additionalProperties: false

examples:
  - |
    #include <dt-bindings/clock/mediatek,mt6785-clk.h>
    #include <dt-bindings/gpio/gpio.h>
    #include <dt-bindings/interrupt-controller/arm-gic.h>
    #include <dt-bindings/reset/mediatek,mt6785-resets.h>

    soc {
        #address-cells = <2>;
        #size-cells = <2>;

        modem@10209000 {
            compatible = "mediatek,mt6785-ccci";
            reg = <0 0x10209000 0 0x1000>,
                  <0 0x1020a000 0 0x1000>,
                  <0 0x1024d000 0 0x1000>,
                  <0 0x1001a824 0 0x10>,
                  <0 0x20000024 0 0x4>,
                  <0 0x10014000 0 0x400>,
                  <0 0x10014400 0 0x400>,
                  <0 0x1022d000 0 0x100>,
                  <0 0x1022d100 0 0x300>,
                  <0 0x1022d400 0 0x400>,
                  <0 0x1022c000 0 0x1000>,
                  <0 0x1022e000 0 0x1000>;
            reg-names = "ap-ccif", "md-ccif", "md-ccif4", "sec-ao", "md-boot",
                        "dpmaif-ao-ul", "dpmaif-ao-dl", "dpmaif-pd-ul",
                        "dpmaif-pd-dl", "dpmaif-pd-misc", "dpmaif-pd-md-misc",
                        "dpmaif-sram";
            interrupts = <GIC_SPI 77 IRQ_TYPE_EDGE_FALLING>,
                         <GIC_SPI 174 IRQ_TYPE_LEVEL_LOW>,
                         <GIC_SPI 175 IRQ_TYPE_LEVEL_LOW>,
                         <GIC_SPI 199 IRQ_TYPE_LEVEL_HIGH>;
            interrupt-names = "mdwdt", "ccif0-data", "ccif0-ctrl", "dpmaif";
            clocks = <&infracfg CLK_INFRA_CCIF_AP>,
                     <&infracfg CLK_INFRA_CCIF_MD>,
                     <&infracfg CLK_INFRA_CCIF1_AP>,
                     <&infracfg CLK_INFRA_CCIF1_MD>,
                     <&infracfg CLK_INFRA_CCIF2_AP>,
                     <&infracfg CLK_INFRA_CCIF2_MD>,
                     <&infracfg CLK_INFRA_CCIF4_MD>,
                     <&infracfg CLK_INFRA_DPMAIF>;
            clock-names = "ccif-ap", "ccif-md", "ccif1-ap", "ccif1-md",
                          "ccif2-ap", "ccif2-md", "ccif4-md", "dpmaif";
            resets = <&infracfg MT6785_INFRA_CCIF0_RST>,
                     <&infracfg MT6785_INFRA_DPMAIF_AO_RST>,
                     <&infracfg MT6785_INFRA_DPMAIF_PD_RST>;
            reset-names = "ccif0", "dpmaif-ao", "dpmaif-pd";
            mediatek,infracfg = <&infracfg>;
            mediatek,infracfg-nao = <&infracfg_nao>;
            mediatek,scpsys = <&scpsys>;
            mediatek,pwrap = <&pwrap>;
            vmodem-supply = <&vmodem>;
            vsram-md-supply = <&vsram_md>;
            mediatek,swtp-gpios = <&pio 13 GPIO_ACTIVE_LOW>;
        };
    };
```

## Documentation/devicetree/bindings/phy/mediatek,mt8365-csi-rx.yaml
```yaml
# SPDX-License-Identifier: (GPL-2.0-only OR BSD-2-Clause)
# Copyright (c) 2023 MediaTek, BayLibre
%YAML 1.2
---
$id: http://devicetree.org/schemas/phy/mediatek,mt8365-csi-rx.yaml#
$schema: http://devicetree.org/meta-schemas/core.yaml#

title: Mediatek Sensor Interface MIPI CSI CD-PHY

maintainers:
  - Julien Stephan <jstephan@baylibre.com>
  - Andy Hsieh <andy.hsieh@mediatek.com>

description:
  The SENINF CD-PHY is a set of CD-PHY connected to the SENINF CSI-2
  receivers. The number of PHYs depends on the SoC model.
  Depending on the SoC model, each PHYs can be either CD-PHY or D-PHY only
  capable.

properties:
  compatible:
    enum:
      - mediatek,mt6785-csi-rx
      - mediatek,mt8365-csi-rx

  reg:
    maxItems: 1
    description:
      Register window of one CSI port; on MT6785 the 0x4000 window with the
      analog halves A and B and the D-PHY top block.

  num-lanes:
    enum: [2, 3, 4]

  '#phy-cells':
    enum: [0, 1]
    description: |
      If the PHY doesn't support mode selection then #phy-cells must be 0 and
      PHY mode is described using phy-type property.
      If the PHY supports mode selection, then #phy-cells must be 1 and mode
      is set in the PHY cells. Supported modes are:
        - PHY_TYPE_DPHY
        - PHY_TYPE_CPHY
      See include/dt-bindings/phy/phy.h for constants.

  nvmem-cells:
    maxItems: 2
    description:
      MT6785 only, optional. Efuse words with the HS termination trimming of
      the A and B half of the port.

  nvmem-cell-names:
    items:
      - const: csi-a
      - const: csi-b

  mediatek,efuse-hsrt-shift:
    $ref: /schemas/types.yaml#/definitions/uint32-array
    items:
      - description: lowest code bit in the efuse word of the A half
        maximum: 17
      - description: lowest code bit in the efuse word of the B half
        maximum: 17
    description:
      MT6785 only, optional. Position of the three 5-bit HS termination
      codes in the efuse words, given as the bit of the lowest code (17 for
      codes in bits 31:17, the default, 2 for codes in bits 16:2).

  phy-type:
    description:
      If the PHY doesn't support mode selection then this set the operating mode.
      See include/dt-bindings/phy/phy.h for constants.
    const: 10
    $ref: /schemas/types.yaml#/definitions/uint32

required:
  - compatible
  - reg
  - num-lanes
  - '#phy-cells'

additionalProperties: false

examples:
  - |
    #include <dt-bindings/phy/phy.h>
    soc {
      #address-cells = <2>;
      #size-cells = <2>;

      csi0_rx: phy@11c10000 {
        compatible = "mediatek,mt8365-csi-rx";
        reg = <0 0x11c10000 0 0x2000>;
        num-lanes = <2>;
        #phy-cells = <1>;
      };

      csi1_rx: phy@11c12000 {
        compatible = "mediatek,mt8365-csi-rx";
        reg = <0 0x11c12000 0 0x2000>;
        phy-type = <PHY_TYPE_DPHY>;
        num-lanes = <2>;
        #phy-cells = <0>;
      };
    };
...
```

## Documentation/devicetree/bindings/power/supply/mediatek,mt6359-gauge.yaml
```yaml
# SPDX-License-Identifier: (GPL-2.0-only OR BSD-2-Clause)
%YAML 1.2
---
$id: http://devicetree.org/schemas/power/supply/mediatek,mt6359-gauge.yaml#
$schema: http://devicetree.org/meta-schemas/core.yaml#

title: MediaTek MT6359 PMIC fuel gauge

maintainers:
  - Matthias Brugger <matthias.bgg@gmail.com>

description:
  The fuel gauge block (FGADC) of the MT6359 PMIC measures the battery
  current over an external sense resistor and integrates it in a coulomb
  counter. Together with the battery voltage and temperature from IIO
  channels and the data of the monitored battery it forms the battery
  power supply. The node is a child of the MT6359 PMIC node.

allOf:
  - $ref: power-supply.yaml#

properties:
  compatible:
    const: mediatek,mt6359-gauge

  io-channels:
    minItems: 1
    items:
      - description: battery voltage
      - description: battery temperature

  io-channel-names:
    minItems: 1
    items:
      - const: voltage
      - const: temperature

  monitored-battery: true

  shunt-resistor-micro-ohms:
    description:
      Effective resistance of the current sense resistor, including any
      board specific correction of the gauge gain.
    default: 5000

required:
  - compatible
  - io-channels
  - io-channel-names
  - monitored-battery

unevaluatedProperties: false

examples:
  - |
    #include <dt-bindings/iio/adc/mediatek,mt6359-auxadc.h>

    fuel-gauge {
        compatible = "mediatek,mt6359-gauge";
        io-channels = <&pmic_adc MT6359_AUXADC_BATADC>, <&battery_ntc>;
        io-channel-names = "voltage", "temperature";
        monitored-battery = <&battery>;
        power-supplies = <&charger>;
        shunt-resistor-micro-ohms = <5263>;
    };
```

## Documentation/devicetree/bindings/power/supply/mt6360_charger.yaml
```yaml
# SPDX-License-Identifier: (GPL-2.0-only OR BSD-2-Clause)
%YAML 1.2
---
$id: http://devicetree.org/schemas/power/supply/mt6360_charger.yaml#
$schema: http://devicetree.org/meta-schemas/core.yaml#

title: Battery charger driver for MT6360 PMIC from MediaTek Integrated.

maintainers:
  - Gene Chen <gene_chen@richtek.com>

description: |
  This module is part of the MT6360 MFD device.
  Provides Battery Charger, Boost for OTG devices and BC1.2 detection.

properties:
  compatible:
    const: mediatek,mt6360-chg

  richtek,vinovp-microvolt:
    description: Maximum CHGIN regulation voltage in uV.
    enum: [ 5500000, 6500000, 11000000, 14500000 ]

  monitored-battery:
    description: |
      simple-battery node. constant-charge-voltage-max-microvolt,
      constant-charge-current-max-microamp, precharge-current-microamp and
      charge-term-current-microamp are programmed at probe; requests from
      user space stay within the first two.
      operating-range-celsius enables a temperature guard that clears
      CHG_EN outside the range (needs mediatek,battery-thermal-zone).
      Between operating-range-celsius and alert-celsius the guard charges
      with the cool and warm limits below.

  input-current-limit-microamp:
    description: Input current limit (AICR) programmed at probe.
    minimum: 100000
    maximum: 3250000

  richtek,safety-timer-hours:
    description: Enable the fast charge safety timer with this duration.
    $ref: /schemas/types.yaml#/definitions/uint32
    enum: [ 4, 6, 8, 10, 12, 14, 16, 20 ]

  richtek,disable-charger-watchdog:
    type: boolean
    description: Clear the charger I2C watchdog, so that programmed limits
      are not reset to defaults when the host does not kick it.

  mediatek,battery-thermal-zone:
    $ref: /schemas/types.yaml#/definitions/phandle
    description: Thermal zone node measuring the battery temperature.

  mediatek,cool-charge-current-microamp:
    description: Charge current limit between the lower ends of
      operating-range-celsius and alert-celsius of the monitored battery.
    minimum: 100000
    maximum: 5000000

  mediatek,cool-charge-voltage-microvolt:
    description: Charge voltage limit between the lower ends of
      operating-range-celsius and alert-celsius of the monitored battery.
    minimum: 3900000
    maximum: 4710000

  mediatek,warm-charge-current-microamp:
    description: Charge current limit between the upper ends of
      alert-celsius and operating-range-celsius of the monitored battery.
    minimum: 100000
    maximum: 5000000

  mediatek,warm-charge-voltage-microvolt:
    description: Charge voltage limit between the upper ends of
      alert-celsius and operating-range-celsius of the monitored battery.
    minimum: 3900000
    maximum: 4710000

  mediatek,input-source:
    $ref: /schemas/types.yaml#/definitions/phandle
    description: Device whose power supply describes the charger input, such
      as the USB Type-C port controller. The input current limit follows its
      current_max, and above 5.5 V MIVR is set 1.2 V below its voltage_now.

  usb-otg-vbus-regulator:
    type: object
    description: OTG boost regulator.
    $ref: /schemas/regulator/regulator.yaml#
    unevaluatedProperties: false

required:
  - compatible

additionalProperties: false

examples:
  - |
    mt6360_charger: charger {
      compatible = "mediatek,mt6360-chg";
      richtek,vinovp-microvolt = <14500000>;

      otg_vbus_regulator: usb-otg-vbus-regulator {
        regulator-name = "usb-otg-vbus";
        regulator-min-microvolt = <4425000>;
        regulator-max-microvolt = <5825000>;
      };
    };
...
```
