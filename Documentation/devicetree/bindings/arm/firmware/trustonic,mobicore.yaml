## Documentation/devicetree/bindings/arm/firmware/trustonic,mobicore.yaml
```yaml
# SPDX-License-Identifier: (GPL-2.0-only OR BSD-2-Clause)
%YAML 1.2
---
$id: http://devicetree.org/schemas/arm/firmware/trustonic,mobicore.yaml#
$schema: http://devicetree.org/meta-schemas/core.yaml#

title: Trustonic MobiCore trusted execution environment

maintainers:
  - masterxq <masterxq@users.noreply.github.com>

description: |
  Trusted execution environment in the secure world of the SoC, reached with secure
  monitor calls. The node only carries the interrupt with which the secure world
  notifies the normal world. Compatible string and interrupt follow the vendor kernel
  device tree.

properties:
  compatible:
    const: trustonic,mobicore

  interrupts:
    maxItems: 1

required:
  - compatible
  - interrupts

additionalProperties: false

examples:
  - |
    #include <dt-bindings/interrupt-controller/arm-gic.h>

    mobicore {
        compatible = "trustonic,mobicore";
        interrupts = <GIC_SPI 89 IRQ_TYPE_EDGE_RISING>;
    };
```

## Documentation/devicetree/bindings/display/bridge/mediatek,mt6382.yaml
```yaml
# SPDX-License-Identifier: (GPL-2.0-only OR BSD-2-Clause)
%YAML 1.2
---
$id: http://devicetree.org/schemas/display/bridge/mediatek,mt6382.yaml#
$schema: http://devicetree.org/meta-schemas/core.yaml#

title: MediaTek MT6382 MIPI-DSI to MIPI-DSI bridge with DSC

maintainers:
  - masterxq <masterxq@users.noreply.github.com>

description: |
  The MT6382 receives uncompressed video from a SoC DSI host (up to four
  lanes), compresses it with DSC and sends it to a DSC panel through its own
  DSI transmitter. The chip is controlled through a MediaTek specific SPI
  slave protocol with 32-bit register addresses, sent LSB first. It also provides a 26 MHz
  clock output that some boards use for the NFC controller.

  Supplies are not described: the external rails of the chip are not
  documented and on the known boards they are always on.

allOf:
  - $ref: /schemas/spi/spi-peripheral-props.yaml#

properties:
  compatible:
    const: mediatek,mt6382

  reg:
    maxItems: 1

  spi-max-frequency:
    maximum: 55000000

  spi-lsb-first: true

  reset-gpios:
    maxItems: 1
    description: Active-low reset input (RESETB).

  clocks:
    maxItems: 1
    description: 26 MHz reference clock.

  "#clock-cells":
    const: 0
    description: The bridge can output its 26 MHz reference clock (e.g. for NFC).

  clock-output-names:
    maxItems: 1

  "#address-cells":
    const: 1

  "#size-cells":
    const: 0

  ports:
    $ref: /schemas/graph.yaml#/properties/ports

    properties:
      port@0:
        $ref: /schemas/graph.yaml#/$defs/port-base
        unevaluatedProperties: false
        description: DSI input from the SoC DSI host.

        properties:
          endpoint:
            $ref: /schemas/media/video-interfaces.yaml#
            unevaluatedProperties: false

            properties:
              data-lanes:
                minItems: 1
                maxItems: 4

      port@1:
        $ref: /schemas/graph.yaml#/properties/port
        description: DSI output to the panel.

patternProperties:
  "^panel@[0-3]$":
    type: object
    description:
      The panel on the DSI output of the bridge; the bridge is its DSI host
      (commands go through the transmitter command queue).

required:
  - compatible
  - reg

unevaluatedProperties: false

examples:
  - |
    #include <dt-bindings/gpio/gpio.h>

    spi {
        #address-cells = <1>;
        #size-cells = <0>;

        bridge@0 {
            compatible = "mediatek,mt6382";
            reg = <0>;
            spi-max-frequency = <55000000>;
            spi-lsb-first;
            reset-gpios = <&pio 32 GPIO_ACTIVE_LOW>;

            ports {
                #address-cells = <1>;
                #size-cells = <0>;

                port@0 {
                    reg = <0>;

                    bridge_in: endpoint {
                        remote-endpoint = <&dsi_out>;
                        data-lanes = <1 2 3 4>;
                    };
                };

                port@1 {
                    reg = <1>;

                    bridge_out: endpoint {
                        remote-endpoint = <&panel_in>;
                    };
                };
            };
        };
    };
```

## Documentation/devicetree/bindings/display/panel/tianma,ili7807s-lisbon.yaml
```yaml
# SPDX-License-Identifier: (GPL-2.0-only OR BSD-2-Clause)
%YAML 1.2
---
$id: http://devicetree.org/schemas/display/panel/tianma,ili7807s-lisbon.yaml#
$schema: http://devicetree.org/meta-schemas/core.yaml#

title: Tianma ILI7807S 1080x2460 DSC panel (Motorola Moto G60s)

maintainers:
  - masterxq <masterxq@users.noreply.github.com>

description: |
  Video-mode MIPI-DSI panel with an Ilitek ILI7807S controller, 4 lanes,
  DSC 1.1 at 8 bpp. On the Motorola Moto G60s it is driven by the DSI
  transmitter of a MediaTek MT6382 bridge, which does the compression.
  The bias supply chip is not described; its enable lines are plain GPIOs
  here.

allOf:
  - $ref: panel-common.yaml#

properties:
  compatible:
    const: tianma,ili7807s-lisbon

  reg:
    maxItems: 1

  reset-gpios: true

  vddi-enable-gpios:
    maxItems: 1
    description: Enable of the LCD I/O LDO.

  enp-gpios:
    maxItems: 1
    description: Enable of the positive bias rail.

  enn-gpios:
    maxItems: 1
    description: Enable of the negative bias rail.

  backlight: true
  port: true

required:
  - compatible
  - reg
  - reset-gpios
  - port

additionalProperties: false

examples:
  - |
    #include <dt-bindings/gpio/gpio.h>

    dsi {
        #address-cells = <1>;
        #size-cells = <0>;

        panel@0 {
            compatible = "tianma,ili7807s-lisbon";
            reg = <0>;
            reset-gpios = <&pio 44 GPIO_ACTIVE_LOW>;
            vddi-enable-gpios = <&pio 88 GPIO_ACTIVE_HIGH>;
            enp-gpios = <&pio 23 GPIO_ACTIVE_HIGH>;
            enn-gpios = <&pio 202 GPIO_ACTIVE_HIGH>;
            backlight = <&backlight>;

            port {
                panel_in: endpoint {
                    remote-endpoint = <&bridge_out>;
                };
            };
        };
    };
```

## Documentation/devicetree/bindings/gnss/mediatek,mt6785-gnss.yaml
```yaml
# SPDX-License-Identifier: (GPL-2.0-only OR BSD-2-Clause)
%YAML 1.2
---
$id: http://devicetree.org/schemas/gnss/mediatek,mt6785-gnss.yaml#
$schema: http://devicetree.org/meta-schemas/core.yaml#

title: MediaTek MT6785 CONNAC1 GNSS

maintainers:
  - masterxq <masterxq@users.noreply.github.com>

description: |
  GNSS function of the MT6785 connectivity subsystem ("soc1_0"). It has no registers of
  its own: the data stream of the GNSS DSP travels over the BTIF/STP link of the consys
  node referenced with mediatek,consys, which also powers the subsystem and switches the
  function on and off. The positioning engine runs on the application processor.

properties:
  compatible:
    const: mediatek,mt6785-gnss

  mediatek,consys:
    $ref: /schemas/types.yaml#/definitions/phandle
    description: The connectivity subsystem (mediatek,mt6785-consys) that carries this function.

  lna-gpios:
    maxItems: 1
    description: Enable of the external low noise amplifier, driven while the receiver runs.

required:
  - compatible
  - mediatek,consys
  - lna-gpios

additionalProperties: false

examples:
  - |
    #include <dt-bindings/gpio/gpio.h>

    gnss {
        compatible = "mediatek,mt6785-gnss";
        mediatek,consys = <&consys>;
        lna-gpios = <&pio 155 GPIO_ACTIVE_HIGH>;
    };
```

## Documentation/devicetree/bindings/input/touchscreen/ilitek,ili7807s.yaml
```yaml
# SPDX-License-Identifier: (GPL-2.0-only OR BSD-2-Clause)
%YAML 1.2
---
$id: http://devicetree.org/schemas/input/touchscreen/ilitek,ili7807s.yaml#
$schema: http://devicetree.org/meta-schemas/core.yaml#

title: ILITEK ILI7807S TDDI touchscreen controller (SPI)

maintainers:
  - Dmitry Torokhov <dmitry.torokhov@gmail.com>

description:
  Touch part of the ILITEK ILI7807S touch and display driver integration
  (TDDI) chip, connected over SPI. The touch controller has no flash; the
  host downloads its firmware into RAM after every touch reset. The display
  part of the chip has its own reset line, which is not described here.

allOf:
  - $ref: touchscreen.yaml#
  - $ref: /schemas/spi/spi-peripheral-props.yaml#

properties:
  compatible:
    const: ilitek,ili7807s

  reg:
    maxItems: 1

  interrupts:
    maxItems: 1

  reset-gpios:
    maxItems: 1
    description: Touch reset line (TP_RST), not the display reset.

  vdd-supply:
    description: Touch analog supply.

  vio-supply:
    description: Touch I/O supply.

  firmware-name:
    maxItems: 1
    description: Firmware file (ILITEK Intel HEX format) to download.

  panel:
    $ref: /schemas/types.yaml#/definitions/phandle
    description:
      Display panel of the same chip. A power cycle of the panel (bias, display
      reset) also resets the touch part, so the driver follows the panel state
      and downloads the firmware again after the panel is enabled.

  spi-max-frequency:
    maximum: 15000000

required:
  - compatible
  - reg
  - interrupts
  - reset-gpios

unevaluatedProperties: false

examples:
  - |
    #include <dt-bindings/gpio/gpio.h>
    #include <dt-bindings/interrupt-controller/irq.h>

    spi {
        #address-cells = <1>;
        #size-cells = <0>;

        touchscreen@0 {
            compatible = "ilitek,ili7807s";
            reg = <0>;
            spi-max-frequency = <10000000>;
            interrupts-extended = <&pio 1 IRQ_TYPE_EDGE_FALLING>;
            reset-gpios = <&pio 2 GPIO_ACTIVE_LOW>;
            firmware-name = "ilitek/ili7807s.hex";
            touchscreen-size-x = <1080>;
            touchscreen-size-y = <2460>;
        };
    };
```

## Documentation/devicetree/bindings/leds/backlight/awinic,aw99703.yaml
```yaml
# SPDX-License-Identifier: (GPL-2.0-only OR BSD-2-Clause)
%YAML 1.2
---
$id: http://devicetree.org/schemas/leds/backlight/awinic,aw99703.yaml#
$schema: http://devicetree.org/meta-schemas/core.yaml#

title: Awinic AW99703 3-channel WLED Backlight Driver

maintainers:
  - masterxq <masterxq@users.noreply.github.com>

description:
  I2C controlled boost converter with three WLED current sinks and 11-bit
  brightness. Boost, current and ramp settings are left to the bootloader
  and not described.

allOf:
  - $ref: common.yaml#

properties:
  compatible:
    const: awinic,aw99703

  reg:
    maxItems: 1

  enable-gpios:
    description: GPIO connected to the HWEN pin.
    maxItems: 1

required:
  - compatible
  - reg

unevaluatedProperties: false

examples:
  - |
    #include <dt-bindings/gpio/gpio.h>

    i2c {
        #address-cells = <1>;
        #size-cells = <0>;

        backlight@36 {
            compatible = "awinic,aw99703";
            reg = <0x36>;
            enable-gpios = <&pio 22 GPIO_ACTIVE_HIGH>;
        };
    };

...
```

## Documentation/devicetree/bindings/media/i2c/ovti,ov02b1b.yaml
```yaml
# SPDX-License-Identifier: (GPL-2.0-only OR BSD-2-Clause)
%YAML 1.2
---
$id: http://devicetree.org/schemas/media/i2c/ovti,ov02b1b.yaml#
$schema: http://devicetree.org/meta-schemas/core.yaml#

title: OmniVision OV02B1B monochrome image sensor

maintainers:
  - masterxq <masterxq@users.noreply.github.com>

description: |
  The OmniVision OV02B1B is a 2 megapixel monochrome CMOS image sensor with a
  single lane MIPI CSI-2 output. It is controlled over I2C with 8-bit register
  addresses in pages selected by register 0xfd; the chip ID is in registers 0x02
  and 0x03 of page 0. The sensor is powered by an analog (AVDD) and an I/O
  (DOVDD) supply, an optional core supply (DVDD), and clocked by an external
  clock. The active low power-down line keeps it powered down.

allOf:
  - $ref: /schemas/media/video-interface-devices.yaml#

properties:
  compatible:
    const: ovti,ov02b1b

  reg:
    maxItems: 1

  clocks:
    description: External clock of the sensor.
    maxItems: 1

  avdd-supply:
    description: Analog supply, 2.8 V.

  dovdd-supply:
    description: Digital I/O supply, 1.8 V.

  dvdd-supply:
    description: Digital core supply, if not generated internally.

  powerdown-gpios:
    description: Power-down line, active low.
    maxItems: 1

  port:
    $ref: /schemas/graph.yaml#/$defs/port-base
    additionalProperties: false
    description: Output port, a single endpoint for the CSI-2 transmitter.

    properties:
      endpoint:
        $ref: /schemas/media/video-interfaces.yaml#
        unevaluatedProperties: false

        properties:
          data-lanes:
            maxItems: 1

          link-frequencies: true

required:
  - compatible
  - reg
  - clocks
  - avdd-supply
  - dovdd-supply

unevaluatedProperties: false

examples:
  - |
    #include <dt-bindings/gpio/gpio.h>

    i2c {
        #address-cells = <1>;
        #size-cells = <0>;

        camera@3d {
            compatible = "ovti,ov02b1b";
            reg = <0x3d>;
            clocks = <&camera_mclk>;
            avdd-supply = <&cam_avdd>;
            dovdd-supply = <&cam_dovdd>;
            powerdown-gpios = <&pio 197 GPIO_ACTIVE_LOW>;
            orientation = <1>;
        };
    };
...
```

## Documentation/devicetree/bindings/media/i2c/ovti,ov64b40.yaml
```yaml
# SPDX-License-Identifier: (GPL-2.0-only OR BSD-2-Clause)
%YAML 1.2
---
$id: http://devicetree.org/schemas/media/i2c/ovti,ov64b40.yaml#
$schema: http://devicetree.org/meta-schemas/core.yaml#

title: OmniVision OV64B40 and OV16A1Q Quad Bayer image sensors

maintainers:
  - masterxq <masterxq@users.noreply.github.com>

description: |
  The OmniVision OV64B40 (64 megapixel) and OV16A1Q (16 megapixel) are Quad
  Bayer CMOS image sensors with a MIPI CSI-2 output of up to four data lanes.
  They are controlled over I2C with 16-bit register addresses and 8-bit values;
  the chip ID is in registers 0x300b and 0x300c. The sensor is powered by an
  analog (AVDD), an I/O (DOVDD) and a core (DVDD) supply and clocked by an
  external clock (XVCLK). The active low XSHUTDN line keeps it in reset.

allOf:
  - $ref: /schemas/media/video-interface-devices.yaml#

properties:
  compatible:
    enum:
      - ovti,ov16a1q
      - ovti,ov64b40

  reg:
    maxItems: 1

  clocks:
    description: XVCLK, the external clock of the sensor.
    maxItems: 1

  avdd-supply:
    description: Analog supply, 2.8 V.

  dovdd-supply:
    description: Digital I/O supply, 1.8 V.

  dvdd-supply:
    description: Digital core supply.

  reset-gpios:
    description: XSHUTDN line, active low.
    maxItems: 1

  port:
    $ref: /schemas/graph.yaml#/$defs/port-base
    additionalProperties: false
    description: Output port, a single endpoint for the CSI-2 transmitter.

    properties:
      endpoint:
        $ref: /schemas/media/video-interfaces.yaml#
        unevaluatedProperties: false

        properties:
          data-lanes:
            minItems: 1
            maxItems: 4

          link-frequencies: true

required:
  - compatible
  - reg
  - clocks
  - avdd-supply
  - dovdd-supply
  - dvdd-supply

unevaluatedProperties: false

examples:
  - |
    #include <dt-bindings/gpio/gpio.h>

    i2c {
        #address-cells = <1>;
        #size-cells = <0>;

        camera@22 {
            compatible = "ovti,ov64b40";
            reg = <0x22>;
            clocks = <&camera_mclk>;
            avdd-supply = <&cam_avdd>;
            dovdd-supply = <&cam_dovdd>;
            dvdd-supply = <&cam_dvdd>;
            reset-gpios = <&pio 124 GPIO_ACTIVE_LOW>;
            lens-focus = <&vcm>;
            orientation = <1>;
            rotation = <90>;

            port {
                endpoint {
                    data-lanes = <1 2 3 4>;
                    link-frequencies = /bits/ 64 <849600000>;
                    remote-endpoint = <&seninf_csi2_in>;
                };
            };
        };
    };
...
```
