## Documentation/devicetree/bindings/media/i2c/samsung,s5k4h7.yaml
```yaml
# SPDX-License-Identifier: (GPL-2.0-only OR BSD-2-Clause)
%YAML 1.2
---
$id: http://devicetree.org/schemas/media/i2c/samsung,s5k4h7.yaml#
$schema: http://devicetree.org/meta-schemas/core.yaml#

title: Samsung S5K4H7 and S5K5E9 image sensors

maintainers:
  - masterxq <masterxq@users.noreply.github.com>

description: |
  The Samsung S5K4H7 (8 megapixel, up to four MIPI CSI-2 data lanes) and S5K5E9
  (5 megapixel, up to two data lanes) are Bayer CMOS image sensors with
  one-time programmable memory. They are controlled over I2C with 16-bit
  register addresses; the chip ID is in registers 0x0000 and 0x0001. The sensor
  is powered by an analog (AVDD), a core (DVDD) and an I/O (DOVDD) supply and
  clocked by an external clock. The active low XSHUTDOWN line keeps it in
  reset.

allOf:
  - $ref: /schemas/media/video-interface-devices.yaml#
  - if:
      properties:
        compatible:
          contains:
            const: samsung,s5k5e9
    then:
      properties:
        port:
          properties:
            endpoint:
              properties:
                data-lanes:
                  maxItems: 2

properties:
  compatible:
    enum:
      - samsung,s5k4h7
      - samsung,s5k5e9

  reg:
    maxItems: 1

  clocks:
    description: External clock of the sensor.
    maxItems: 1

  avdd-supply:
    description: Analog supply, 2.8 V.

  dvdd-supply:
    description: Digital core supply.

  dovdd-supply:
    description: Digital I/O supply, 1.8 V.

  reset-gpios:
    description: XSHUTDOWN line, active low.
    maxItems: 1

  mux-states:
    description:
      Position of a board MIPI CSI-2 switch that connects the sensor to the
      receiver, selected while the sensor streams.
    maxItems: 1

  port:
    $ref: /schemas/graph.yaml#/$defs/port-base
    additionalProperties: false
    description: Output port, a single endpoint for the CSI-2 transmitter.

    properties:
      endpoint:
        $ref: /schemas/media/video-interfaces.yaml#
        unevaluatedProperties: false

        properties:
          data-lanes:
            minItems: 1
            maxItems: 4

          link-frequencies: true

required:
  - compatible
  - reg
  - clocks
  - avdd-supply
  - dvdd-supply
  - dovdd-supply

unevaluatedProperties: false

examples:
  - |
    #include <dt-bindings/gpio/gpio.h>

    i2c {
        #address-cells = <1>;
        #size-cells = <0>;

        camera@2d {
            compatible = "samsung,s5k4h7";
            reg = <0x2d>;
            clocks = <&camera_mclk>;
            avdd-supply = <&cam_avdd>;
            dvdd-supply = <&cam_dvdd>;
            dovdd-supply = <&cam_dovdd>;
            reset-gpios = <&pio 118 GPIO_ACTIVE_LOW>;
            mux-states = <&cam_mipi_switch 1>;
            orientation = <1>;

            port {
                endpoint {
                    data-lanes = <1 2 3 4>;
                    link-frequencies = /bits/ 64 <350000000>;
                    remote-endpoint = <&csi0_in>;
                };
            };
        };

        camera@10 {
            compatible = "samsung,s5k5e9";
            reg = <0x10>;
            clocks = <&camera_mclk2>;
            avdd-supply = <&cam_avdd>;
            dvdd-supply = <&cam_dvdd>;
            dovdd-supply = <&cam_dovdd>;
            reset-gpios = <&pio 125 GPIO_ACTIVE_LOW>;
            mux-states = <&cam_mipi_switch 0>;
            orientation = <1>;

            port {
                endpoint {
                    data-lanes = <1 2>;
                    link-frequencies = /bits/ 64 <438000000>;
                    remote-endpoint = <&csi0a_in>;
                };
            };
        };
    };
...
```

## Documentation/devicetree/bindings/media/mediatek,mt6785-dip.yaml
```yaml
# SPDX-License-Identifier: (GPL-2.0-only OR BSD-2-Clause)
%YAML 1.2
---
$id: http://devicetree.org/schemas/media/mediatek,mt6785-dip.yaml#
$schema: http://devicetree.org/meta-schemas/core.yaml#

title: MediaTek MT6785 ISP pass 2 (DIP)

maintainers:
  - masterxq <masterxq@users.noreply.github.com>

description:
  The DIP (digital image processing) block is the second pass of the MT6785
  image signal processor. It reads raw frames from memory, processes them and
  writes the result back to memory through the IOMMU, on ports 0-6 of SMI
  larb5.

properties:
  compatible:
    const: mediatek,mt6785-dip

  reg:
    maxItems: 1

  interrupts:
    maxItems: 1

  power-domains:
    maxItems: 1

  clocks:
    items:
      - description: DIP clock

  clock-names:
    items:
      - const: dip

  iommus:
    maxItems: 7
    description:
      The larb5 ports of the DIP (IMGI, IMG2O, IMG3O, VIPI, LCEI, SMXI, SMXO),
      see include/dt-bindings/memory/mediatek,mt6785-memory-port.h.

required:
  - compatible
  - reg
  - interrupts
  - power-domains
  - clocks
  - clock-names
  - iommus

additionalProperties: false

examples:
  - |
    #include <dt-bindings/clock/mediatek,mt6785-clk.h>
    #include <dt-bindings/interrupt-controller/arm-gic.h>
    #include <dt-bindings/interrupt-controller/irq.h>
    #include <dt-bindings/memory/mediatek,mt6785-memory-port.h>
    #include <dt-bindings/power/mediatek,mt6785-power.h>

    soc {
        #address-cells = <2>;
        #size-cells = <2>;

        dip@15022000 {
            compatible = "mediatek,mt6785-dip";
            reg = <0 0x15022000 0 0x6000>;
            interrupts = <GIC_SPI 292 IRQ_TYPE_LEVEL_LOW>;
            clocks = <&imgsys CLK_IMG_DIP>;
            clock-names = "dip";
            power-domains = <&spm MT6785_POWER_DOMAIN_ISP>;
            iommus = <&iommu M4U_PORT_IMG_IMGI>,
                     <&iommu M4U_PORT_IMG_IMG2O>,
                     <&iommu M4U_PORT_IMG_IMG3O>,
                     <&iommu M4U_PORT_IMG_VIPI>,
                     <&iommu M4U_PORT_IMG_LCEI>,
                     <&iommu M4U_PORT_IMG_SMXI>,
                     <&iommu M4U_PORT_IMG_SMXO>;
        };
    };
...
```

## Documentation/devicetree/bindings/media/mediatek,mt6785-mdp-linear.yaml
```yaml
# SPDX-License-Identifier: (GPL-2.0-only OR BSD-2-Clause)
%YAML 1.2
---
$id: http://devicetree.org/schemas/media/mediatek,mt6785-mdp-linear.yaml#
$schema: http://devicetree.org/meta-schemas/core.yaml#

title: MediaTek MT6785 memory video format converter

maintainers:
  - masterxq <masterxq@users.noreply.github.com>

description:
  The memory path contains a block-layout reader and a linear image writer.
  A multimedia mutex synchronizes the stream; GCE programs stripe transfers.
  The memory ports are attached to SMI larb1. No coprocessor is involved.

properties:
  compatible:
    const: mediatek,mt6785-mdp-linear
  reg:
    items:
      - description: Memory reader registers
      - description: Image writer registers
  reg-names:
    items:
      - const: reader
      - const: writer
  clocks:
    maxItems: 2
  clock-names:
    items:
      - const: reader
      - const: writer
  power-domains:
    maxItems: 1
  iommus:
    maxItems: 3
  mboxes:
    maxItems: 1
  mediatek,mmsys:
    $ref: /schemas/types.yaml#/definitions/phandle
    description: Multimedia stream routing controller
  mediatek,mutex:
    $ref: /schemas/types.yaml#/definitions/phandle
    description: Multimedia synchronization controller
  mediatek,gce-client-reg:
    $ref: /schemas/types.yaml#/definitions/phandle-array
    items:
      items:
        - description: GCE controller
        - description: Register subsystem identifier
        - description: Register window offset
        - description: Register window size
    description: GCE register window containing the reader and writer
  mediatek,gce-events:
    description: Stream start and completion event identifiers for GCE
    $ref: /schemas/types.yaml#/definitions/uint32-array
    items:
      - description: Reader stream start
      - description: Writer stream start
      - description: Reader frame completion
      - description: Writer memory completion

required:
  - compatible
  - reg
  - reg-names
  - clocks
  - clock-names
  - power-domains
  - iommus
  - mboxes
  - mediatek,mmsys
  - mediatek,mutex
  - mediatek,gce-client-reg
  - mediatek,gce-events

additionalProperties: false

examples:
  - |
    #include <dt-bindings/clock/mediatek,mt6785-clk.h>
    #include <dt-bindings/memory/mediatek,mt6785-memory-port.h>
    #include <dt-bindings/power/mediatek,mt6785-power.h>
    soc {
        #address-cells = <2>;
        #size-cells = <2>;
        video-converter@14001000 {
            compatible = "mediatek,mt6785-mdp-linear";
            reg = <0 0x14001000 0 0x1000>, <0 0x14005000 0 0x1000>;
            reg-names = "reader", "writer";
            clocks = <&mmsys CLK_MM_MDP_RDMA0>, <&mmsys CLK_MM_MDP_WROT0>;
            clock-names = "reader", "writer";
            power-domains = <&spm MT6785_POWER_DOMAIN_MM>;
            iommus = <&iommu M4U_PORT_MDP_RDMA0>,
                     <&iommu M4U_PORT_MDP_WROT0_R>, <&iommu M4U_PORT_MDP_WROT0_W>;
            mboxes = <&gce 16 0>;
            mediatek,mmsys = <&mmsys>;
            mediatek,mutex = <&mutex>;
            mediatek,gce-client-reg = <&gce 1 0 0x6000>;
            mediatek,gce-events = <2 7 30 35>;
        };
    };
```

## Documentation/devicetree/bindings/media/mediatek,mt6785-mfb.yaml
```yaml
# SPDX-License-Identifier: (GPL-2.0-only OR BSD-2-Clause)
%YAML 1.2
---
$id: http://devicetree.org/schemas/media/mediatek,mt6785-mfb.yaml#
$schema: http://devicetree.org/meta-schemas/core.yaml#

title: MediaTek MT6785 multi-frame blending block (MFB)

maintainers:
  - masterxq <masterxq@users.noreply.github.com>

description:
  The MFB block of the MT6785 image signal processor blends a reference
  image into a base image under control of a per-pixel weight map and
  writes the blended image and the updated weight map, from memory to
  memory, through the IOMMU on three ports of SMI larb5. Multi-frame noise
  reduction runs it once per additional frame.

properties:
  compatible:
    const: mediatek,mt6785-mfb

  reg:
    maxItems: 1

  interrupts:
    maxItems: 1

  power-domains:
    maxItems: 1

  clocks:
    items:
      - description: MFB clock

  clock-names:
    items:
      - const: mfb

  iommus:
    maxItems: 3
    description:
      The larb5 ports of the MFB (RDMA0, RDMA1, WDMA), see
      include/dt-bindings/memory/mediatek,mt6785-memory-port.h.

required:
  - compatible
  - reg
  - interrupts
  - power-domains
  - clocks
  - clock-names
  - iommus

additionalProperties: false

examples:
  - |
    #include <dt-bindings/clock/mediatek,mt6785-clk.h>
    #include <dt-bindings/interrupt-controller/arm-gic.h>
    #include <dt-bindings/interrupt-controller/irq.h>
    #include <dt-bindings/memory/mediatek,mt6785-memory-port.h>
    #include <dt-bindings/power/mediatek,mt6785-power.h>

    soc {
        #address-cells = <2>;
        #size-cells = <2>;

        mfb@1502e000 {
            compatible = "mediatek,mt6785-mfb";
            reg = <0 0x1502e000 0 0x1000>;
            interrupts = <GIC_SPI 300 IRQ_TYPE_LEVEL_LOW>;
            clocks = <&imgsys CLK_IMG_MFB>;
            clock-names = "mfb";
            power-domains = <&spm MT6785_POWER_DOMAIN_ISP>;
            iommus = <&iommu M4U_PORT_IMG_MFB_RDMA0>,
                     <&iommu M4U_PORT_IMG_MFB_RDMA1>,
                     <&iommu M4U_PORT_IMG_MFB_WDMA>;
        };
    };
...
```

## Documentation/devicetree/bindings/media/mediatek,mt6785-seninf.yaml
```yaml
# SPDX-License-Identifier: (GPL-2.0-only OR BSD-2-Clause)
%YAML 1.2
---
$id: http://devicetree.org/schemas/media/mediatek,mt6785-seninf.yaml#
$schema: http://devicetree.org/meta-schemas/core.yaml#

title: MediaTek MT6785 Sensor Interface

maintainers:
  - masterxq <masterxq@users.noreply.github.com>

description:
  The MT6785 SENINF receives CSI-2 data from up to five sensors (CSI0, CSI1
  and CSI2 in 4-lane mode, or CSI0 split into CSI0A and CSI0B) and routes it
  through six MUXes and a CAM mux crossbar to the raw ISP (CAM A/B) and to
  the CAMSV DMA engines. It belongs to the newer SENINF generation with a
  separate CSI-2 receiver block per input; the analog D-PHYs are separate
  devices (mediatek,mt6785-csi-rx).

properties:
  compatible:
    const: mediatek,mt6785-seninf

  reg:
    maxItems: 1

  interrupts:
    maxItems: 1

  power-domains:
    maxItems: 1

  clocks:
    items:
      - description: camsys SENINF gate
      - description: topckgen SENINF mux
      - description: topckgen SENINF1 mux
      - description: topckgen SENINF2 mux

  clock-names:
    items:
      - const: camsys
      - const: top_mux
      - const: top_mux1
      - const: top_mux2

  phys:
    minItems: 1
    maxItems: 4
    description: D-PHYs of the connected inputs, named after the port

  phy-names:
    minItems: 1
    maxItems: 4
    items:
      enum: [ csi0, csi1, csi2, csi0b ]

  ports:
    $ref: /schemas/graph.yaml#/properties/ports

    patternProperties:
      "^port@[0-3]$":
        $ref: /schemas/graph.yaml#/$defs/port-base
        unevaluatedProperties: false
        description:
          CSI-2 inputs, port 0 CSI0 (SENINF1), 1 CSI1 (SENINF3), 2 CSI2
          (SENINF5), 3 CSI0B (SENINF2). An input has one endpoint per
          sensor. Sensors behind a board switch in front of the port share
          the input with one endpoint each (endpoint@0, endpoint@1), each
          with its own lane configuration; one of them streams at a time.

        patternProperties:
          "^endpoint(@[01])?$":
            $ref: video-interfaces.yaml#
            unevaluatedProperties: false

            properties:
              clock-lanes:
                maxItems: 1
              data-lanes:
                minItems: 1
                maxItems: 4

      "^port@[4-7]$":
        $ref: /schemas/graph.yaml#/properties/port
        description: outputs, MUX0..3 towards CAMSV1..4

required:
  - compatible
  - reg
  - clocks
  - clock-names
  - power-domains
  - ports

additionalProperties: false

examples:
  - |
    #include <dt-bindings/clock/mediatek,mt6785-clk.h>
    #include <dt-bindings/power/mediatek,mt6785-power.h>

    soc {
        #address-cells = <2>;
        #size-cells = <2>;

        seninf@1a040000 {
            compatible = "mediatek,mt6785-seninf";
            reg = <0 0x1a040000 0 0x8000>;
            clocks = <&camsys CLK_CAM_SENINF>,
                     <&topckgen CLK_TOP_SENINF0>,
                     <&topckgen CLK_TOP_SENINF1>,
                     <&topckgen CLK_TOP_SENINF2>;
            clock-names = "camsys", "top_mux", "top_mux1", "top_mux2";
            power-domains = <&spm MT6785_POWER_DOMAIN_CAM>;
            phys = <&csi1_rx>, <&csi0_rx>;
            phy-names = "csi1", "csi0";

            ports {
                #address-cells = <1>;
                #size-cells = <0>;

                /* two sensors behind a board switch */
                port@0 {
                    reg = <0>;
                    #address-cells = <1>;
                    #size-cells = <0>;

                    endpoint@0 {
                        reg = <0>;
                        data-lanes = <1 2>;
                        remote-endpoint = <&macro_out>;
                    };

                    endpoint@1 {
                        reg = <1>;
                        data-lanes = <1 2 3 4>;
                        remote-endpoint = <&wide_out>;
                    };
                };

                port@1 {
                    reg = <1>;
                    endpoint {
                        data-lanes = <1 2 3 4>;
                        remote-endpoint = <&sensor_out>;
                    };
                };

                port@4 {
                    reg = <4>;
                    endpoint {
                        remote-endpoint = <&camsv1_in>;
                    };
                };
            };
        };
    };
...
```
