## drivers/media/platform/mediatek/isp/Kconfig
```kconfig
# SPDX-License-Identifier: GPL-2.0-only

config MTK_CAMSV
	tristate "MediaTek ISP3.0 CAMSV driver"
	depends on ARCH_MEDIATEK || COMPILE_TEST
	depends on OF
	depends on PM
	depends on VIDEO_DEV
	select MEDIA_CONTROLLER
	select MTK_SENINF30
	select VIDEO_V4L2_SUBDEV_API
	select VIDEOBUF2_DMA_CONTIG
	default n
	help
	  This driver provides a path to bypass the SoC ISP so that
	  image data come from the SENINF can go directly into memory
	  without any image processing.

	  To compile this driver as a module, choose M here: the
	  module will be called mtk-camsv.

config MTK_SENINF30
	tristate "MediaTek ISP3.0 SENINF driver"
	depends on ARCH_MEDIATEK || COMPILE_TEST
	depends on OF
	depends on VIDEO_DEV
	select GENERIC_PHY
	select MEDIA_CONTROLLER
	select PHY_MTK_MIPI_CSI_0_5
	select V4L2_FWNODE
	select VIDEO_V4L2_SUBDEV_API
	default n
	help
	  This driver provides a MIPI CSI-2 receiver interface to connect
	  an external camera module with MediaTek ISP3.0. It is able to handle
	  multiple cameras at the same time.

	  To compile this driver as a module, choose M here: the
	  module will be called mtk-seninf.

config MTK_SENINF30_KUNIT_TEST
	bool "KUnit tests of the MediaTek ISP3.0 SENINF driver" if !KUNIT_ALL_TESTS
	depends on MTK_SENINF30 && KUNIT=y
	default KUNIT_ALL_TESTS
	help
	  Tests of the stream state of the SENINF: while a stream runs, the
	  same routing table leaves the stream configurations untouched,
	  another routing table and a new active format on either end of the
	  stream are refused, and the other streams can still be configured.

	  If unsure, say N.
```

## drivers/media/platform/mediatek/mdp-linear/Kconfig
```kconfig
# SPDX-License-Identifier: GPL-2.0-only
config VIDEO_MEDIATEK_MDP_LINEAR
	tristate "MediaTek firmware-free video detiler"
	depends on VIDEO_DEV && HAS_DMA
	depends on MTK_IOMMU || COMPILE_TEST
	depends on MTK_MMSYS && MTK_CMDQ
	select VIDEOBUF2_DMA_CONTIG
	select V4L2_MEM2MEM_DEV
	help
	  Convert MT6785 decoder block layouts into linear NV12 or P010
	  buffers through V4L2 mem2mem, with DMA-BUF import and export.
	  No SCP firmware is used. The driver does not decode compressed
	  video, scale images, or perform HDR tone mapping.

	  The module is called mtk-mdp-linear.
```

## drivers/soc/mediatek/Kconfig
```kconfig
# SPDX-License-Identifier: GPL-2.0-only
#
# MediaTek SoC drivers
#
menu "MediaTek SoC drivers"
	depends on ARCH_MEDIATEK || COMPILE_TEST

config MTK_CMDQ
	tristate "MediaTek CMDQ Support"
	depends on ARCH_MEDIATEK || COMPILE_TEST
	select MAILBOX
	select MTK_CMDQ_MBOX
	select MTK_INFRACFG
	help
	  Say yes here to add support for the MediaTek Command Queue (CMDQ)
	  driver. The CMDQ is used to help read/write registers with critical
	  time limitation, such as updating display configuration during the
	  vblank.

config MTK_CONNAC1_CONSYS
	tristate "MediaTek CONNAC1 connectivity subsystem power control"
	depends on ARCH_MEDIATEK || COMPILE_TEST
	depends on OF
	depends on MFD_SYSCON && RESET_CONTROLLER && REGULATOR
	select CRC32
	select FW_LOADER
	help
	  Say yes here to support powering the integrated CONNAC1
	  connectivity subsystem (WLAN/BT/GPS/FM, "soc1_0") of the MT6785:
	  supplies, CONN power domain, CONN MCU reset and the RAM patches
	  in the reserved EMI region, up to the "MCU ready" state. Power-on
	  is triggered from user space through sysfs; nothing is switched
	  on at probe time.

config MTK_CONNAC1_GPS
	tristate "MediaTek CONNAC1 GNSS function (/dev/stpgps)"
	depends on MTK_CONNAC1_CONSYS
	depends on GPIOLIB
	depends on RFKILL || !RFKILL
	help
	  Character device /dev/stpgps for the GNSS receiver of the MT6785
	  connectivity subsystem. It switches the GNSS function on while the
	  device is open and passes the data stream of the GNSS DSP through,
	  with the interface of the vendor driver (stp_chrdev_gps). Positions
	  need a positioning engine in user space; there is no NMEA output in
	  the kernel. An rfkill switch of type GPS powers the receiver down.

	  To compile this driver as a module, choose M here: the module will
	  be called mtk-connac1-gps.

config MTK_DEVAPC
	tristate "Mediatek Device APC Support"
	help
	  Say yes here to enable support for Mediatek Device APC driver.
	  This driver is mainly used to handle the violation which catches
	  unexpected transaction.
	  The violation information is logged for further analysis or
	  countermeasures.

config MTK_DVFSRC
	tristate "MediaTek DVFSRC Support"
	depends on ARCH_MEDIATEK
	help
	  Say yes here to add support for the MediaTek Dynamic Voltage
	  and Frequency Scaling Resource Collector (DVFSRC): a HW
	  IP found on many MediaTek SoCs, which is responsible for
	  collecting DVFS requests from various SoC IPs, other than
	  software, and performing bandwidth scaling to provide the
	  best achievable performance-per-watt.

config MTK_INFRACFG
	bool "MediaTek INFRACFG Support"
	select REGMAP
	help
	  Say yes here to add support for the MediaTek INFRACFG controller. The
	  INFRACFG controller contains various infrastructure registers not
	  directly associated to any device.

config MTK_LISBON_SPM
	tristate "MT6785 SPM firmware diagnostics (lisbon)"
	depends on ARCH_MEDIATEK && ARM64 && DEBUG_FS
	depends on HAVE_ARM_SMCCC
	help
	  Shows in debugfs whether the vendor TF-A on MT6785 has the SPM
	  firmware loaded and started, and allows starting the SPM firmware
	  ("kick") by hand. Debugging aid for system suspend; say N if unsure.

config MTK_PMIC_WRAP
	tristate "MediaTek PMIC Wrapper Support"
	depends on RESET_CONTROLLER
	depends on OF
	select REGMAP
	help
	  Say yes here to add support for MediaTek PMIC Wrapper found
	  on different MediaTek SoCs. The PMIC wrapper is a proprietary
	  hardware to connect the PMIC.

config MTK_REGULATOR_COUPLER
	bool "MediaTek SoC Regulator Coupler" if COMPILE_TEST
	default ARCH_MEDIATEK
	depends on REGULATOR

config MTK_MMSYS
	tristate "MediaTek MMSYS Support"
	default ARCH_MEDIATEK
	depends on HAS_IOMEM
	depends on MTK_CMDQ || MTK_CMDQ=n
	help
	  Say yes here to add support for the MediaTek Multimedia
	  Subsystem (MMSYS).

config MTK_SVS
	tristate "MediaTek Smart Voltage Scaling(SVS)"
	depends on NVMEM_MTK_EFUSE && NVMEM
	help
	  The Smart Voltage Scaling(SVS) engine is a piece of hardware
	  which has several controllers(banks) for calculating suitable
	  voltage to different power domains(CPU/GPU/CCI) according to
	  chip process corner, temperatures and other factors. Then DVFS
	  driver could apply SVS bank voltage to PMIC/Buck.

config MTK_SOCINFO
	tristate "MediaTek SoC Information"
	default y
	depends on NVMEM_MTK_EFUSE
	select SOC_BUS
	help
	  The MediaTek SoC Information (mtk-socinfo) driver provides
	  information about the SoC to the userspace including the
	  manufacturer name, marketing name and soc name.

config MTK_CPU_SIP
	bool "MediaTek legacy TF-A CPU power-down SiP call after hotplug"
	depends on ARM64 && HAVE_ARM_SMCCC
	help
	  After a CPU went offline through PSCI CPU_OFF, issue the vendor SiP
	  call MTK_SIP_POWER_DOWN_CORE like the MT6785 vendor kernel does.
	  Only active on MT6785 and only while the run-time parameter
	  mtk_cpu_sip.power_down_core is set. Debugging aid; say N if unsure.

endmenu
```
