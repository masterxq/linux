// SPDX-License-Identifier: (GPL-2.0 OR MIT)
/*
 * Motorola Moto G60s (lisbon) base description: PMIC, UFS, touchscreen and charger, without the
 * MT6382 bridge and the AW99703 backlight.
 */

#include "mt6785-motorola-lisbon-ufs.dts"
#include "mt6785-motorola-lisbon-touch.dtsi"
#include "mt6785-motorola-lisbon-charger.dtsi"
