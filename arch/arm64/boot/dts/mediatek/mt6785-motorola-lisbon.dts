// SPDX-License-Identifier: (GPL-2.0 OR MIT)
/* Motorola Moto G60s (lisbon) */

#include "mt6785-motorola-lisbon-m1.dts"
#include "mt6785-motorola-lisbon-mt6382.dtsi"
#include "mt6785-motorola-lisbon-backlight.dtsi"
#include "mt6785-motorola-lisbon-idle.dtsi"
#include "mt6785-motorola-lisbon-thermal.dtsi"
#include "mt6785-motorola-lisbon-pd.dtsi"
#include "mt6785-motorola-lisbon-keys.dtsi"
#include "mt6785-motorola-lisbon-flash.dtsi"
#include "mt6785-motorola-lisbon-haptic.dtsi"
#include "mt6785-motorola-lisbon-keypad.dtsi"
#include "mt6785-motorola-lisbon-ntc.dtsi"
